## build-edgeos-headless/conf/bblayers.conf
```bitbake
LCONF_VERSION = "7"

BBPATH = "${TOPDIR}"
BSPDIR := "${@os.path.abspath(os.path.dirname(d.getVar('FILE', True)) + '/../..')}"

BBFILES ?= ""

# Yocto / OE core
BBLAYERS = " \
  ${BSPDIR}/sources/poky/meta \
  ${BSPDIR}/sources/poky/meta-poky \
  \
  ${BSPDIR}/sources/meta-openembedded/meta-oe \
  ${BSPDIR}/sources/meta-openembedded/meta-multimedia \
  ${BSPDIR}/sources/meta-openembedded/meta-python \
  ${BSPDIR}/sources/meta-openembedded/meta-networking \
  ${BSPDIR}/sources/meta-openembedded/meta-filesystems \
  \
  ${BSPDIR}/sources/meta-freescale \
  ${BSPDIR}/sources/meta-freescale-3rdparty \
  ${BSPDIR}/sources/meta-freescale-distro \
"

# NXP / i.MX BSP
BBLAYERS += "${BSPDIR}/sources/meta-imx/meta-imx-bsp"
BBLAYERS += "${BSPDIR}/sources/meta-imx/meta-imx-sdk"
BBLAYERS += "${BSPDIR}/sources/meta-imx/meta-imx-ml"
BBLAYERS += "${BSPDIR}/sources/meta-imx/meta-imx-v2x"

# NXP connectivity (Matter / OpenThread)
BBLAYERS += "${BSPDIR}/sources/meta-nxp-connectivity/meta-nxp-matter-baseline"
BBLAYERS += "${BSPDIR}/sources/meta-nxp-connectivity/meta-nxp-openthread"

# Toolchain
BBLAYERS += "${BSPDIR}/sources/meta-arm/meta-arm"
BBLAYERS += "${BSPDIR}/sources/meta-arm/meta-arm-toolchain"
BBLAYERS += "${BSPDIR}/sources/meta-clang"

# Security
BBLAYERS += "${BSPDIR}/sources/meta-security/meta-parsec"
BBLAYERS += "${BSPDIR}/sources/meta-security/meta-tpm"
BBLAYERS += "${BSPDIR}/sources/meta-timesys"

# Virtualisation (containers / Xen)
BBLAYERS += "${BSPDIR}/sources/meta-virtualization"

# ROS 2 Humble
BBLAYERS += "${BSPDIR}/sources/meta-ros/meta-ros-common"
BBLAYERS += "${BSPDIR}/sources/meta-ros/meta-ros2"
BBLAYERS += "${BSPDIR}/sources/meta-ros/meta-ros2-humble"

# EdgeOS product layer
BBLAYERS += "${BSPDIR}/sources/meta-edgeos"
```

## build-edgeos-headless/conf/local.conf
```bitbake
# ===========================================================================
# local.conf: build-environment overrides ONLY.
#
# Product identity (DISTRO_NAME, hostname, image packages, security policy)
# lives in sources/meta-edgeos. This file only controls the local build
# environment and should NOT be shared as-is between developers without
# editing the absolute paths below.
# ===========================================================================

# Target.
MACHINE = "imx8mp-lpddr4-evk"
DISTRO  = "edgeos"

# Build infrastructure.
CONF_VERSION = "2"
ACCEPT_FSL_EULA = "1"

# Persistent caches. These survive a workspace wipe or re-clone.
# Keep them on a stable path. On a new machine, copy downloads/ and
# sstate-cache/ here and the build will skip downloading and most
# compilation automatically.
DL_DIR     = "/home/mentor/cra-imx-linux/downloads"
SSTATE_DIR = "/home/mentor/cra-imx-linux/sstate-cache"

# Parallelism, tuned for a 32 GB RAM host.
# Rule of thumb: BB_NUMBER_THREADS * avg-peak-RAM-per-task < available RAM.
# Heavy tasks here are onnxruntime (8-12 GB at link time), TFLite (4-6 GB)
# and OpenCV (2-3 GB). With 32 GB and no swap, 6 tasks at 3 make threads
# keeps the peak under roughly 28 GB. Add a swapfile (see bin/edgeos-host-setup)
# for headroom.
BB_NUMBER_THREADS = "6"
PARALLEL_MAKE     = "-j 3"

# Per-recipe caps for known memory-intensive C++ builds:
# onnxruntime does LLVM-style optimisation passes that can spike to 8-12 GB.
# Pin it to a single make thread on 32 GB hosts so it cannot co-link with itself.
PARALLEL_MAKE:pn-onnxruntime        = "-j 1"
# TFLite links large XNNPack / RUY objects. 2 threads is the safe ceiling on 32 GB.
PARALLEL_MAKE:pn-tensorflow-lite    = "-j 2"
# VX delegate links against the GC GPU stack, also heavy at link time.
PARALLEL_MAKE:pn-tensorflow-lite-vx-delegate = "-j 1"
# OpenCV with contrib modules can spike during template instantiation.
PARALLEL_MAKE:pn-opencv             = "-j 3"
# ROS 2 C++ packages use heavy template metaprogramming.
PARALLEL_MAKE:pn-ros-base           = "-j 3"
PARALLEL_MAKE:pn-rclcpp             = "-j 3"

# Complete in-progress tasks before spawning new ones. Reduces memory peaks
# by preventing multiple heavyweight link phases from overlapping.
BB_SCHEDULER = "completion"

# Build statistics and conflict resolution.
USER_CLASSES  ?= "buildstats"
PATCHRESOLVE   = "noop"

# Disk space guards.
BB_DISKMON_DIRS ??= "\
    STOPTASKS,${TMPDIR},1G,100K \
    STOPTASKS,${DL_DIR},1G,100K \
    STOPTASKS,${SSTATE_DIR},1G,100K \
    STOPTASKS,/tmp,100M,100K \
    HALT,${TMPDIR},100M,1K \
    HALT,${DL_DIR},100M,1K \
    HALT,${SSTATE_DIR},100M,1K \
    HALT,/tmp,10M,1K"

PACKAGECONFIG:append:pn-qemu-system-native = " sdl"

# Disk space management.
# Delete each recipe's work directory after it is successfully packaged.
# Saves 100-200 GB on a full build. The sstate-cache preserves build output
# so recipes are not rebuilt on the next run.
INHERIT += "rm_work"
# Keep these around in case we need to inspect them after a failure.
RM_WORK_EXCLUDE += "onnxruntime tensorflow-lite python3-ultralytics"

# CVE database: use cached copy, never fetch live from NVD during builds.
# The NVD API rate-limits aggressively and can stall the build indefinitely.
CVE_DB_UPDATE_INTERVAL = "-1"

# Fetch mirrors.
# Rust crates from crates.io are rate-limited and occasionally unreachable.
# Point the crate:// fetcher at the Yocto public mirror first so the build
# does not stall waiting for crates.io retries.
PREMIRRORS:prepend = "crate://crates.io/.* https://downloads.yoctoproject.org/mirror/sources/ \n"

# Note for 32 GB hosts:
# Before the first build, run:    sudo bin/edgeos-host-setup
# That script sets vm.overcommit_memory=1, vm.swappiness=10, and creates a
# 32 GB swapfile at /swapfile_edgeos. Without these tweaks, the onnxruntime
# and TFLite link phases will OOM-kill the bitbake worker on a 32 GB host.
```

## sources/meta-edgeos/conf/distro/edgeos.conf
```bitbake
# EdgeOS: headless real-time robotics/edge-AI distro for the i.MX8 family.
# Inherits the NXP framebuffer base (no compositor, minimal display stack).
require conf/distro/fsl-imx-fb.conf

DISTRO          = "edgeos"
DISTRO_NAME     = "EdgeOS"
DISTRO_VERSION  = "1.0"
DISTRO_CODENAME = "robotics-r1"

# Default hostname at image level.
hostname:pn-base-files = "edgeos-device"

# Package format. IPK is the lightest format for on-device opkg.
PACKAGE_CLASSES = "package_ipk"

# Display / window-system features.
# fsl-imx-fb already strips x11/wayland. Also remove vulkan and directfb,
# which are unused on a headless robotics node.
DISTRO_FEATURES:remove = "vulkan directfb"

# CRA (Cyber Resilience Act) compliance.
# CVE scanning runs at parse time for every recipe. Reports land in tmp/log/cve/.
INHERIT += "cve-check"

# SPDX SBOM is generated automatically alongside every image artefact.
INHERIT += "create-spdx"

# Open-source license compliance (required for public distribution).
# Embed a per-package license manifest and the full license texts into the
# image under /usr/share/licenses/. Required for GPL/LGPL written-offer
# compliance.
COPY_LIC_MANIFEST = "1"
COPY_LIC_DIRS     = "1"

# Archive patched source for every GPL, LGPL and AGPL package.
# Output lands in DEPLOY_DIR/sources/ and must be hosted alongside the image
# download to satisfy copyleft source-availability obligations.
INHERIT += "archiver"
ARCHIVER_MODE[src]  = "patched"
ARCHIVER_MODE[diff] = "0"
COPYLEFT_LICENSE_INCLUDE = "GPL* LGPL* AGPL*"
COPYLEFT_LICENSE_EXCLUDE = "CLOSED Proprietary"
COPYLEFT_RECIPE_TYPES    = "target"

# NXP proprietary binary blobs.
# Several NXP packages (firmware-ele-imx, imx-gpu-viv, imx-vpu-hantro,
# imx-codec, imx-gpu-g2d) are distributed under the NXP Software License
# Agreement. ACCEPT_FSL_EULA = "1" in local.conf permits building them.
#
# DISTRIBUTION REQUIREMENT:
# Before making the built image publicly available, the download page MUST
# present the NXP EULA and require acceptance before the download starts.
# The full EULA text is at:
#   sources/meta-imx/meta-imx-bsp/EULA  (or NXP's website)
# This is a legal requirement; failing to do this violates the NXP licence.
#
# AGPL-3.0 notice (python3-ultralytics):
# ultralytics is AGPL-3.0-only. For free / open distribution this is fine
# provided the corresponding source is accessible to all recipients. Upstream
# is permanently available at:
#   https://github.com/ultralytics/ultralytics  (tag v8.3.119)
# The archiver class above also captures the deployed source archive.
```

## sources/meta-edgeos/conf/layer.conf
```bitbake
BBPATH .= ":${LAYERDIR}"

BBFILES += "${LAYERDIR}/recipes-*/*/*.bb \
            ${LAYERDIR}/recipes-*/*/*.bbappend"

BBFILE_COLLECTIONS += "edgeos"
BBFILE_PATTERN_edgeos = "^${LAYERDIR}/"
BBFILE_PRIORITY_edgeos = "10"

LAYERDEPENDS_edgeos = "core fsl-bsp-release fsl-sdk-release"
LAYERSERIES_COMPAT_edgeos = "scarthgap"
```
